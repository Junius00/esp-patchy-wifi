## main/Kconfig.projbuild
```kconfig
menu "Patchy Wi-Fi Configuration"

    config PATCHY_AP_SSID
        string "SoftAP SSID"
        default "patchy-wifi"
        help
            SSID advertised by the chip's SoftAP. Client devices connect to this
            network to route their traffic through the gateway.

    config PATCHY_AP_PASSWORD
        string "SoftAP password (>=8 chars, empty = open)"
        default "patchywifi"
        help
            WPA2-PSK passphrase for the SoftAP. Must be at least 8 characters,
            or leave empty to run an open network (no auth).

    config PATCHY_AP_CHANNEL
        int "SoftAP channel"
        range 1 13
        default 1
        help
            Wi-Fi channel for the SoftAP. When STA is connected, the SoftAP is
            forced onto the STA's channel regardless of this value (radio
            limitation), so this mainly matters for the pre-STA window.

    config PATCHY_AP_MAX_STA
        int "Max stations on SoftAP"
        range 1 10
        default 4
        help
            Upper bound on concurrent clients associated to the SoftAP.

    config PATCHY_JITTER_UPTIME_MIN_S
        int "Jittery: min seconds AP 'online' between outages"
        default 60
        help
            In jittery mode, the forwarding-up interval is picked uniformly at
            random from [MIN_S, MAX_S]. Lower both values for quick validation.

    config PATCHY_JITTER_UPTIME_MAX_S
        int "Jittery: max seconds AP 'online' between outages"
        default 240
        help
            Upper bound for the random uptime interval. Must be >= MIN_S.

    config PATCHY_JITTER_DOWNTIME_MIN_S
        int "Jittery: min seconds AP 'offline' per outage"
        default 5
        help
            In jittery mode, each simulated outage lasts a random duration in
            [MIN_S, MAX_S] with NAPT disabled on the SoftAP netif.

    config PATCHY_JITTER_DOWNTIME_MAX_S
        int "Jittery: max seconds AP 'offline' per outage"
        default 10
        help
            Upper bound for the random downtime interval. Must be >= MIN_S.

    config PATCHY_BUTTON_GPIO
        int "Button GPIO (BOOT button)"
        default 9
        help
            GPIO connected to the control button. Default 9 matches the BOOT
            button on most ESP32-C3/C6 DevKits. ESP32 classic BOOT is GPIO 0.

    config PATCHY_BUTTON_ACTIVE_LEVEL
        int "Button active level (0 = low / BOOT, 1 = high)"
        range 0 1
        default 0
        help
            Logic level when the button is pressed. BOOT buttons pull the line
            low when pressed, so keep 0 for the standard DevKit wiring.

    config PATCHY_LED_BRIGHTNESS
        int "LED brightness (0=off, 255=full brightness)"
        default 64
        help
            Brightness level of the RGB LED.
            0=off, 255=full brightness

    config PATCHY_RESET_HOLD_MS
        int "Button hold duration for network reset (ms)"
        default 5000
        help
            Holding the button for at least this many milliseconds wipes stored
            Wi-Fi credentials and reboots into provisioning mode. Must be
            greater than PATCHY_JITTERY_HOLD_MS so the two gestures don't
            collide.

    config PATCHY_JITTERY_HOLD_MS
        int "Button hold duration to toggle jittery mode (ms)"
        default 1000
        help
            Press-and-release the button after at least this duration (but
            shorter than PATCHY_RESET_HOLD_MS) to toggle jittery mode on/off.

    config PATCHY_PROV_POP
        string "Provisioning proof-of-possession"
        default "patchy1234"
        help
            Shared secret required by the provisioning client (esp-prov CLI or
            ESP BLE Provisioning phone app) to authenticate the Security 1
            handshake. Change this for any non-demo deployment.

endmenu
```

## sdkconfig.defaults
```kconfig
# NAT gateway requirements
CONFIG_LWIP_IP_FORWARD=y
CONFIG_LWIP_IPV4_NAPT=y
CONFIG_LWIP_L2_TO_L3_COPY=y

# Wi-Fi: AP+STA coexistence
CONFIG_ESP_WIFI_SOFTAP_SUPPORT=y

# Bluetooth (NimBLE) for provisioning BLE transport
CONFIG_BT_ENABLED=y
CONFIG_BT_NIMBLE_ENABLED=y
CONFIG_BT_BLUEDROID_ENABLED=n

# rmaker_app_network: BLE transport + QR display
CONFIG_APP_NETWORK_PROV_TRANSPORT_BLE=y
CONFIG_APP_NETWORK_PROV_SHOW_QR=y
CONFIG_APP_NETWORK_PROV_NAME_PREFIX="PATCHY"
# Auto-stop provisioning after N minutes (0 = never)
CONFIG_APP_NETWORK_PROV_TIMEOUT_PERIOD=0

# Custom partition table for NVS headroom
CONFIG_PARTITION_TABLE_CUSTOM=y
CONFIG_PARTITION_TABLE_CUSTOM_FILENAME="partitions.csv"
CONFIG_PARTITION_TABLE_FILENAME="partitions.csv"

# FreeRTOS headroom
CONFIG_ESP_MAIN_TASK_STACK_SIZE=5120
```

## sdkconfig.defaults.esp32
```kconfig
# ESP32 classic: BOOT = GPIO 0
# app_led defaults to WS2812 on GPIO 18 for this target (most DevKits lack an
# on-board RGB LED; wire a WS2812 to GPIO 18 or override in menuconfig).
CONFIG_PATCHY_BUTTON_GPIO=0
```

## sdkconfig.defaults.esp32c2
```kconfig
CONFIG_APP_LED_TYPE_LEDC=y
CONFIG_APP_LED_LEDC_GPIO_NUM_R=0
CONFIG_APP_LED_LEDC_GPIO_NUM_G=1
CONFIG_APP_LED_LEDC_GPIO_NUM_B=8
```

## sdkconfig.defaults.esp32c5
```kconfig
# ESP32-C5: BOOT = GPIO 9 (assumed DevKit default), WS2812 on GPIO 27
CONFIG_APP_LED_TYPE_WS2812=y
CONFIG_APP_LED_WS2812_GPIO_NUM=27
```

## sdkconfig.defaults.esp32s2
```kconfig
# ESP32-S2: no Bluetooth — fall back to SoftAP provisioning transport.
# BOOT = GPIO 0. WS2812 default GPIO 18 via app_led.
CONFIG_PATCHY_BUTTON_GPIO=0

# Switch provisioning transport to SoftAP (S2 has no BLE)
CONFIG_APP_NETWORK_PROV_TRANSPORT_BLE=n
CONFIG_APP_NETWORK_PROV_TRANSPORT_SOFTAP=y

# Disable Bluetooth stack — not supported on S2
CONFIG_BT_ENABLED=n
CONFIG_BT_NIMBLE_ENABLED=n
```

## sdkconfig.defaults.esp32s3
```kconfig
# ESP32-S3: BOOT = GPIO 0, on-board WS2812 on GPIO 48 (ESP32-S3-DevKitC-1)
CONFIG_PATCHY_BUTTON_GPIO=0
CONFIG_APP_LED_TYPE_WS2812=y
CONFIG_APP_LED_WS2812_GPIO_NUM=48
```
